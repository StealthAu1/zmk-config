/*
 * Copyright (c) 2020 The ZMK Contributors
 * Copyright (c) 2025 Innaworks Development Limited, trading as MoErgo
 *
 * SPDX-License-Identifier: MIT
 */


/* THIS FILE WAS GENERATED BY GLOVE80 LAYOUT EDITOR
 *
 * This file was generated automatically. You may or may not want to
 * edit it directly.
 */

#include <behaviors.dtsi>
/* Include all behavior includes needed */
#include <dt-bindings/zmk/outputs.h>
#include <dt-bindings/zmk/keys.h>
#include <dt-bindings/zmk/bt.h>
#include <dt-bindings/zmk/rgb.h>

/* On demand includes */
#include <dt-bindings/zmk/pointing.h>

/* Helper Macros, based on https://github.com/urob/zmk-helpers/ */

#pragma once

#define ZMK_HELPER_STRINGIFY(x) #x

// Preprocessor mechanism to overload macros, cf. https://stackoverflow.com/a/27051616/6114651
#define VARGS_(_10, _9, _8, _7, _6, _5, _4, _3, _2, _1, N, ...) N
#define VARGS(...) VARGS_(__VA_ARGS__, 10, 9, 8, 7, 6, 5, 4, 3, 2, 1, 0)
#define CONCAT_(a, b) a##b
#define CONCAT(a, b) CONCAT_(a, b)

#define ZMK_BEHAVIOR_CORE_tap_dance  \
    compatible = "zmk,behavior-tap-dance"; \
    #binding-cells = <0>

#define ZMK_BEHAVIOR(name, type, ...) \
    name: name { \
        ZMK_BEHAVIOR_CORE_ ## type; \
        __VA_ARGS__ \
    };

#define ZMK_TAP_DANCE(name, ...) \
    ZMK_BEHAVIOR(name, tap_dance, __VA_ARGS__)

#define ZMK_TD_LAYER(name, layer) \
    ZMK_TAP_DANCE(name, \
        tapping-term-ms = <200>; \
        bindings = <&mo layer>, <&to layer>; \
)

/* Environment and metadata defines */
#define KB_TYPE_GLOVE_80 1
#define KB_TYPE_GO_60    2

#define KB_TYPE          KB_TYPE_GLOVE_80
#define EDITOR_HOST_OS   'L'

/* Automatically generated layer name defines */
#define LAYER_Base 0
#define LAYER_Lower 1
#define LAYER_Magic 2
#define LAYER_Mouse 3
#define LAYER_Gaming 4
#define LAYER_Numbers 5
#define LAYER_MouseSlow 6
#define LAYER_MousePrecise 7
#define LAYER_MouseWarp 8
#define LAYER_Mirror 9

/* To deal with the situation where there is no Lower layer, to keep &lower happy */
#ifndef LAYER_Lower
#define LAYER_Lower 0
#endif

/* Custom Device-tree */
//////////////////////////////////////////////////////////////////////////
//
// Mouse keys (keyboard mouse control) requires v24.12 firmware or newer:
// override the "HID_POINTING" setting to "y" in Advanced Configuration
// and then select "v24.12" firmware from the drop-down menu located at
// Glove80 Layout Editor > Settings > Advanced Settings > Firmware Version
//
// Alternatively, you can use either PR23 or PR36 beta firmware for this:
// select "community.pr23.mouse-keys" from the drop-down menu located at
// Glove80 Layout Editor > Settings > Advanced Settings > Firmware Version
//
// - https://github.com/moergo-sc/zmk/pull/23
// - https://gist.github.com/krissen/dd27082e7ab0575619c7a31f4d2ec7ae
// - https://github.com/zmkfirmware/zmk/compare/main...urob:zmk:mouse-3.2
// - https://github.com/caksoylar/zmk-config/commit/0020c23c544cd7111013f0114609d1fb90e0e475
// - https://github.com/caksoylar/zmk-config/commit/e35ee2f08788927683df7bbdd7fc73434473886e
//
//////////////////////////////////////////////////////////////////////////

//
// INVERT_MOUSE_WHEEL reverses the directionality of the mouse scroll wheel
// to provide "natural scrolling" in macOS and similar desktop environments.
//
//#define INVERT_MOUSE_WHEEL

#ifdef INVERT_MOUSE_WHEEL
  #define MOUSE_SCROLL_UP    SCRL_DOWN
  #define MOUSE_SCROLL_DOWN  SCRL_UP
  #define MOUSE_SCROLL_LEFT  SCRL_RIGHT
  #define MOUSE_SCROLL_RIGHT SCRL_LEFT
#else
  #define MOUSE_SCROLL_UP    SCRL_UP
  #define MOUSE_SCROLL_DOWN  SCRL_DOWN
  #define MOUSE_SCROLL_LEFT  SCRL_LEFT
  #define MOUSE_SCROLL_RIGHT SCRL_RIGHT
#endif

//
// MOUSE_MOTION_DELAY defines how long to wait (milliseconds) before starting
// to move the mouse pointer.
//
#ifndef MOUSE_MOTION_DELAY
#define MOUSE_MOTION_DELAY 0
#endif

//
// MOUSE_MOTION_ACCELERATION_EXPONENT sets how the mouse pointer accelerates:
//
// acceleration exponent 0: uniform speed
// acceleration exponent 1: uniform acceleration
// acceleration exponent 2: uniform jerk
//
#ifndef MOUSE_MOTION_ACCELERATION_EXPONENT
#define MOUSE_MOTION_ACCELERATION_EXPONENT 1
#endif

//
// MOUSE_MOTION_TIME_TO_MAXIMUM_SPEED defines how long to wait (milliseconds)
// before the mouse pointer speed is suddenly boosted to the maximum value.
//
#ifndef MOUSE_MOTION_TIME_TO_MAXIMUM_SPEED
#define MOUSE_MOTION_TIME_TO_MAXIMUM_SPEED 300
#endif

//
// MOUSE_MOTION_MAXIMUM_SPEED defines how quickly the mouse pointer can move.
//
#ifndef MOUSE_MOTION_MAXIMUM_SPEED
#define MOUSE_MOTION_MAXIMUM_SPEED 1200
#endif

//
// MOUSE_SCROLL_DELAY defines how long to wait (milliseconds) before starting
// to move the mouse pointer.
//
#ifndef MOUSE_SCROLL_DELAY
#define MOUSE_SCROLL_DELAY 0
#endif

//
// MOUSE_SCROLL_ACCELERATION_EXPONENT sets how the mouse pointer accelerates:
//
// acceleration exponent 0: uniform speed
// acceleration exponent 1: uniform acceleration
// acceleration exponent 2: uniform jerk
//
#ifndef MOUSE_SCROLL_ACCELERATION_EXPONENT
#define MOUSE_SCROLL_ACCELERATION_EXPONENT 1
#endif

//
// MOUSE_SCROLL_TIME_TO_MAXIMUM_SPEED defines how long to wait (milliseconds)
// before the mouse pointer speed is suddenly boosted to the maximum value.
//
#ifndef MOUSE_SCROLL_TIME_TO_MAXIMUM_SPEED
#define MOUSE_SCROLL_TIME_TO_MAXIMUM_SPEED 40
#endif

//
// MOUSE_SCROLL_MAXIMUM_SPEED defines how quickly the mouse wheel can scroll.
//
#ifndef MOUSE_SCROLL_MAXIMUM_SPEED
#define MOUSE_SCROLL_MAXIMUM_SPEED 180
#endif

//
// MOUSE_SCALER_SLOW sets parameters for the &zip_xy_scaler input processor:
// https://zmk.dev/docs/keymaps/input-processors/scaler
//
#ifndef MOUSE_SCALER_SLOW
#define MOUSE_SCALER_SLOW 2 3
#endif

//
// MOUSE_SCALER_NORMAL sets parameters for the &zip_xy_scaler input processor:
// https://zmk.dev/docs/keymaps/input-processors/scaler
//
#ifndef MOUSE_SCALER_NORMAL
#define MOUSE_SCALER_NORMAL 2 1
#endif

//
// MOUSE_SCALER_PRECISE sets parameters for the &zip_xy_scaler input processor:
// https://zmk.dev/docs/keymaps/input-processors/scaler
//
#ifndef MOUSE_SCALER_PRECISE
#define MOUSE_SCALER_PRECISE 4 3
#endif

//
// MOUSE_SCALER_WARP sets parameters for the &zip_xy_scaler input processor:
// https://zmk.dev/docs/keymaps/input-processors/scaler
//
#ifndef MOUSE_SCALER_WARP
#define MOUSE_SCALER_WARP 4 1
#endif

#if 1 // __has_include(<zmk/events/mouse_tick.h>) || ( \
  defined(MOERGO_FIRMWARE_VERSION_MAJOR) &&       \
  defined(MOERGO_FIRMWARE_VERSION_MINOR) && (     \
    MOERGO_FIRMWARE_VERSION_MAJOR == 24 &&        \
    MOERGO_FIRMWARE_VERSION_MINOR == 12 ||        \
    MOERGO_FIRMWARE_VERSION_MAJOR > 24            \
  )                                               \
)
  // ==== MOUSE-KEY <section begins> ====
  #define ZMK_MOUSE_DEFAULT_MOVE_VAL MOUSE_MOTION_MAXIMUM_SPEED
  #define ZMK_MOUSE_DEFAULT_SCRL_VAL MOUSE_SCROLL_MAXIMUM_SPEED
  #include <dt-bindings/zmk/mouse.h>
  &mmv {
    delay-ms = <MOUSE_MOTION_DELAY>;
    acceleration-exponent = <MOUSE_MOTION_ACCELERATION_EXPONENT>;
    time-to-max-speed-ms = <MOUSE_MOTION_TIME_TO_MAXIMUM_SPEED>;
    trigger-period-ms = <16>;
  };
  &msc {
    delay-ms = <MOUSE_SCROLL_DELAY>;
    acceleration-exponent = <MOUSE_SCROLL_ACCELERATION_EXPONENT>;
    time-to-max-speed-ms = <MOUSE_SCROLL_TIME_TO_MAXIMUM_SPEED>;
    trigger-period-ms = <16>;
  };
  //
  // Scaling for mouse movement, based on @caksoylar's example:
  // https://github.com/caksoylar/zmk-config/commit/0020c23c544cd7111013f0114609d1fb90e0e475
  //
  #include <input/processors.dtsi>
  &mmv_input_listener {
    #ifdef LAYER_MouseSlow
    slow {
      layers = <LAYER_MouseSlow>;
      input-processors = <&zip_xy_scaler MOUSE_SCALER_SLOW>;
    };
    #endif
    #ifdef LAYER_MousePrecise
    fast {
      layers = <LAYER_MousePrecise>;
      input-processors = <&zip_xy_scaler MOUSE_SCALER_PRECISE>;
    };
    #endif
    #ifdef LAYER_MouseWarp
    warp {
      layers = <LAYER_MouseWarp>;
      input-processors = <&zip_xy_scaler MOUSE_SCALER_WARP>;
    };
    #endif
    #ifdef LAYER_Mouse
    normal {
      layers = <LAYER_Mouse>;
      input-processors = <&zip_xy_scaler MOUSE_SCALER_NORMAL>;
    };
    #endif
  };
  //
  // Scaling for mouse scrolling, based on @caksoylar's example:
  // https://github.com/caksoylar/zmk-config/commit/e35ee2f08788927683df7bbdd7fc73434473886e
  //
  #include <zephyr/dt-bindings/input/input-event-codes.h>
  / {
    input_processors {
      zip_scroll_scaler: zip_scroll_scaler {
        compatible = "zmk,input-processor-scaler";
        #input-processor-cells = <2>;
        type = <INPUT_EV_REL>;
        codes = <INPUT_REL_WHEEL INPUT_REL_HWHEEL>;
        track-remainders;
      };
    };
  };
  &msc_input_listener {
    #ifdef LAYER_MouseSlow
    slow {
      layers = <LAYER_MouseSlow>;
      input-processors = <&zip_scroll_scaler MOUSE_SCALER_PRECISE>;
    };
    #endif
    #ifdef LAYER_MousePrecise
    fast {
      layers = <LAYER_MousePrecise>;
      input-processors = <&zip_scroll_scaler MOUSE_SCALER_PRECISE>;
    };
    #endif
    #ifdef LAYER_MouseWarp
    warp {
      layers = <LAYER_MouseWarp>;
      input-processors = <&zip_scroll_scaler MOUSE_SCALER_WARP>;
    };
    #endif
    #ifdef LAYER_Mouse
    normal {
      layers = <LAYER_Mouse>;
      input-processors = <&zip_scroll_scaler MOUSE_SCALER_WARP>;
    };
    #endif
  };
  // ==== MOUSE-KEY <section ends> =====
#else
  #define mkp none
  #define mmv none
  #define msc none
  #define LCLK
  #define MCLK
  #define RCLK
  #define MB1
  #define MB2
  #define MB3
  #define MB4
  #define MB5
  #define MB6
  #define MB7
  #define MB8
  #define MOVE_UP
  #define MOVE_DOWN
  #define MOVE_LEFT
  #define MOVE_RIGHT
  #define SCRL_UP
  #define SCRL_DOWN
  #define SCRL_LEFT
  #define SCRL_RIGHT
#endif

/* Input Listeners */


/* System behavior and Macros */
/ {
    behaviors {
        ZMK_TD_LAYER(lower, LAYER_Lower)
    };
};

/ {
    macros {
        rgb_ug_status_macro: rgb_ug_status_macro {
            compatible = "zmk,behavior-macro";
            #binding-cells = <0>;
            bindings
                = <&rgb_ug RGB_STATUS>;
        };
    };
};


/ {
#ifdef BT_DISC_CMD
    behaviors {
        bt_0: bt_0 {
            compatible = "zmk,behavior-tap-dance";
            #binding-cells = <0>;
            tapping-term-ms = <200>;
            bindings = <&bt_select_0>, <&bt BT_DISC 0>;
        };
        bt_1: bt_1 {
            compatible = "zmk,behavior-tap-dance";
            #binding-cells = <0>;
            tapping-term-ms = <200>;
            bindings = <&bt_select_1>, <&bt BT_DISC 1>;
        };
        bt_2: bt_2 {
            compatible = "zmk,behavior-tap-dance";
            #binding-cells = <0>;
            tapping-term-ms = <200>;
            bindings = <&bt_select_2>, <&bt BT_DISC 2>;
        };
        bt_3: bt_3 {
            compatible = "zmk,behavior-tap-dance";
            #binding-cells = <0>;
            tapping-term-ms = <200>;
            bindings = <&bt_select_3>, <&bt BT_DISC 3>;
        };
    };
    macros {
        bt_select_0: bt_select_0 {
            compatible = "zmk,behavior-macro";
            #binding-cells = <0>;
            bindings
                = <&out OUT_BLE>,
                  <&bt BT_SEL 0>;
        };
        bt_select_1: bt_select_1 {
            compatible = "zmk,behavior-macro";
            #binding-cells = <0>;
            bindings
                = <&out OUT_BLE>,
                  <&bt BT_SEL 1>;
        };
        bt_select_2: bt_select_2 {
            compatible = "zmk,behavior-macro";
            #binding-cells = <0>;
            bindings
                = <&out OUT_BLE>,
                  <&bt BT_SEL 2>;
        };
        bt_select_3: bt_select_3 {
            compatible = "zmk,behavior-macro";
            #binding-cells = <0>;
            bindings
                = <&out OUT_BLE>,
                  <&bt BT_SEL 3>;
        };
    };
#else
    macros {
        bt_0: bt_0 {
            compatible = "zmk,behavior-macro";
            #binding-cells = <0>;
            bindings
                = <&out OUT_BLE>,
                  <&bt BT_SEL 0>;
        };
        bt_1: bt_1 {
            compatible = "zmk,behavior-macro";
            #binding-cells = <0>;
            bindings
                = <&out OUT_BLE>,
                  <&bt BT_SEL 1>;
        };
        bt_2: bt_2 {
            compatible = "zmk,behavior-macro";
            #binding-cells = <0>;
            bindings
                = <&out OUT_BLE>,
                  <&bt BT_SEL 2>;
        };
        bt_3: bt_3 {
            compatible = "zmk,behavior-macro";
            #binding-cells = <0>;
            bindings
                = <&out OUT_BLE>,
                  <&bt BT_SEL 3>;
        };
    };
#endif
};

/ {
    behaviors {
        magic: magic {
            compatible = "zmk,behavior-hold-tap";
            #binding-cells = <2>;
            flavor = "tap-preferred";
            tapping-term-ms = <200>;
            bindings = <&mo>, <&rgb_ug_status_macro>;
        };
    };
};


/* Key positions */

#define POS_LH_C6R1 0
#define POS_LH_C5R1 1
#define POS_LH_C4R1 2
#define POS_LH_C3R1 3
#define POS_LH_C2R1 4
#define POS_RH_C2R1 5
#define POS_RH_C3R1 6
#define POS_RH_C4R1 7
#define POS_RH_C5R1 8
#define POS_RH_C6R1 9
#define POS_LH_C6R2 10
#define POS_LH_C5R2 11
#define POS_LH_C4R2 12
#define POS_LH_C3R2 13
#define POS_LH_C2R2 14
#define POS_LH_C1R2 15
#define POS_RH_C1R2 16
#define POS_RH_C2R2 17
#define POS_RH_C3R2 18
#define POS_RH_C4R2 19
#define POS_RH_C5R2 20
#define POS_RH_C6R2 21
#define POS_LH_C6R3 22
#define POS_LH_C5R3 23
#define POS_LH_C4R3 24
#define POS_LH_C3R3 25
#define POS_LH_C2R3 26
#define POS_LH_C1R3 27
#define POS_RH_C1R3 28
#define POS_RH_C2R3 29
#define POS_RH_C3R3 30
#define POS_RH_C4R3 31
#define POS_RH_C5R3 32
#define POS_RH_C6R3 33
#define POS_LH_C6R4 34
#define POS_LH_C5R4 35
#define POS_LH_C4R4 36
#define POS_LH_C3R4 37
#define POS_LH_C2R4 38
#define POS_LH_C1R4 39
#define POS_RH_C1R4 40
#define POS_RH_C2R4 41
#define POS_RH_C3R4 42
#define POS_RH_C4R4 43
#define POS_RH_C5R4 44
#define POS_RH_C6R4 45
#define POS_LH_C6R5 46
#define POS_LH_C5R5 47
#define POS_LH_C4R5 48
#define POS_LH_C3R5 49
#define POS_LH_C2R5 50
#define POS_LH_C1R5 51
#define POS_LH_T1 52
#define POS_LH_T2 53
#define POS_LH_T3 54
#define POS_RH_T3 55
#define POS_RH_T2 56
#define POS_RH_T1 57
#define POS_RH_C1R5 58
#define POS_RH_C2R5 59
#define POS_RH_C3R5 60
#define POS_RH_C4R5 61
#define POS_RH_C5R5 62
#define POS_RH_C6R5 63
#define POS_LH_C6R6 64
#define POS_LH_C5R6 65
#define POS_LH_C4R6 66
#define POS_LH_C3R6 67
#define POS_LH_C2R6 68
#define POS_LH_T4 69
#define POS_LH_T5 70
#define POS_LH_T6 71
#define POS_RH_T6 72
#define POS_RH_T5 73
#define POS_RH_T4 74
#define POS_RH_C2R6 75
#define POS_RH_C3R6 76
#define POS_RH_C4R6 77
#define POS_RH_C5R6 78
#define POS_RH_C6R6 79


/* Custom Defined Behaviors */
/ {
behaviors {
    mousedance: mousedance {
        compatible = "zmk,behavior-tap-dance";
        #binding-cells = <0>;
        tapping-term-ms = <200>;
        bindings = <&mo 3>, <&to 3>;
    };



    shiftdance: shiftdance {
        compatible = "zmk,behavior-tap-dance";
        #binding-cells = <0>;
        tapping-term-ms = <200>;
        bindings = <&sk RSHIFT>, <&kp CAPSLOCK>;
    };


    numdance: numdance {
        compatible = "zmk,behavior-tap-dance";
        #binding-cells = <0>;
        tapping-term-ms = <200>;
        bindings = <&mo 5>, <&to 5>;
    };
};

};

/* Generated input processors */


/* Automatically generated macro definitions */
/ {
    macros {

    };
};

/* Automatically generated behavior definitions */
/ {
    behaviors {


        // Home Row Mods
        hrm: hrm {
            compatible = "zmk,behavior-hold-tap";
            #binding-cells = <2>;
            tapping-term-ms = <200>;
            bindings = <&kp>, <&kp>;
            flavor = "tap-preferred";
        };

        // home row mod for shift keys
        hrms: hrms {
            compatible = "zmk,behavior-hold-tap";
            #binding-cells = <2>;
            tapping-term-ms = <150>;
            bindings = <&kp>, <&kp>;
            flavor = "tap-preferred";
        };

        layers: layers {
            compatible = "zmk,behavior-hold-tap";
            #binding-cells = <2>;
            tapping-term-ms = <200>;
            bindings = <&mo>, <&to>;
        };
    };
};

/* Automatically generated combos definitions */


/* Automatically generated keymap */
/ {
    keymap {
        compatible = "zmk,keymap";


        layer_Base {
            bindings = <
               &kp F1       &kp F2       &kp F3        &kp F4         &kp F5                                                                                                             &kp F6        &kp F7       &kp F8       &kp F9    &kp F10
            &kp EQUAL       &kp N1       &kp N2        &kp N3         &kp N4  &kp N5                                                                                      &kp N6         &kp N7        &kp N8       &kp N9       &kp N0  &kp MINUS
              &kp TAB        &kp Q        &kp W         &kp F          &kp P   &kp B                                                                                       &kp J          &kp L         &kp U        &kp Y     &kp SEMI   &kp BSLH
              &kp ESC  &hrm LGUI A  &hrm LALT R  &hrm LCTRL S  &hrms LSHFT T   &kp G                                                                                       &kp M  &hrms RSHFT N  &hrm RCTRL E  &hrm RALT I  &hrm RGUI O    &kp SQT
            &kp GRAVE        &kp Z        &kp X         &kp C          &kp D   &kp V  &shiftdance  &mousedance            &lower         &numdance  &kp RCTRL  &kp K_APP   &kp K          &kp H     &kp COMMA      &kp DOT     &kp FSLH  &kp PG_UP
 &magic LAYER_Magic 0     &kp HOME      &kp END      &kp LEFT      &kp RIGHT             &kp BSPC      &kp DEL  &mo LAYER_Mirror  &mo LAYER_Mirror    &kp RET  &kp SPACE                 &kp UP      &kp DOWN     &kp LBKT     &kp RBKT  &kp PG_DN
            >;
        };

        layer_Lower {
            bindings = <
         &kp C_BRI_DN  &kp C_BRI_UP      &kp C_PREV      &kp C_NEXT         &kp C_PP                                                                                 &kp C_MUTE  &kp C_VOL_DN  &kp C_VOL_UP            &none  &kp PAUSE_BREAK
               &trans         &none           &none           &none            &none   &kp HOME                                                          &kp LS(N9)  &kp KP_NUM  &kp KP_EQUAL  &kp KP_SLASH  &kp KP_MULTIPLY  &kp PRINTSCREEN
               &trans         &none           &none    &kp UP_ARROW            &none    &kp END                                                          &kp LS(N0)   &kp KP_N7     &kp KP_N8     &kp KP_N9     &kp KP_MINUS   &kp SCROLLLOCK
               &trans         &none  &kp LEFT_ARROW  &kp DOWN_ARROW  &kp RIGHT_ARROW  &kp PG_UP                                                          &kp LS(N5)   &kp KP_N4     &kp KP_N5     &kp KP_N6      &kp KP_PLUS            &none
               &trans     &kp K_APP           &none         &kp F11          &kp F12  &kp PG_DN  &trans  &trans  &to LAYER_Base  &trans  &trans  &trans   &kp COMMA   &kp KP_N1     &kp KP_N2     &kp KP_N3     &kp KP_ENTER           &trans
 &magic LAYER_Magic 0      &kp CAPS         &kp INS         &kp F11          &kp F12             &trans  &trans          &trans  &trans  &trans  &trans               &kp KP_N0     &kp KP_N0    &kp KP_DOT     &kp KP_ENTER           &trans
            >;
        };

        layer_Magic {
            bindings = <
      &bt BT_CLR             &none             &none             &none              &none                                                                                                            &none             &none             &none             &none   &bt BT_CLR_ALL
 &tog LAYER_Base  &tog LAYER_Lower  &tog LAYER_Magic  &tog LAYER_Mouse  &tog LAYER_Gaming  &tog LAYER_Numbers                                                        &tog LAYER_Numbers  &tog LAYER_Gaming  &tog LAYER_Mouse  &tog LAYER_Magic  &tog LAYER_Lower  &tog LAYER_Base
           &none   &rgb_ug RGB_SPI   &rgb_ug RGB_SAI   &rgb_ug RGB_HUI    &rgb_ug RGB_BRI     &rgb_ug RGB_TOG                                                                     &none              &none             &none             &none             &none            &none
     &bootloader   &rgb_ug RGB_SPD   &rgb_ug RGB_SAD   &rgb_ug RGB_HUD    &rgb_ug RGB_BRD     &rgb_ug RGB_EFF                                                                     &none              &none             &none             &none             &none      &bootloader
      &sys_reset             &none             &none             &none              &none               &none   &bt_2   &bt_3         &none   &none   &none   &none               &none              &none             &none             &none             &none       &sys_reset
           &none             &none             &none             &none              &none                       &bt_0   &bt_1  &out OUT_USB   &none   &none   &none                                  &none             &none             &none             &none            &none
            >;
        };

        layer_Mouse {
            bindings = <
            &kp LG(L)        &kp C_BRI_UP              &kp INS                  &kp F7           &kp LA(F4)                                                                                                        &kp C_MUTE    &kp C_VOL_DN     &kp C_VOL_UP           &kp F8      &kp PAUSE_BREAK
               &kp N0              &kp F1               &kp F2                  &kp F3               &kp F4  &kp PG_UP                                                                                 &trans       &kp LSHFT       &kp LCTRL         &kp LALT           &trans      &kp PRINTSCREEN
              &kp TAB              &kp F5               &kp F6                  &kp F7               &kp F8  &kp PG_DN                                                                              &mkp LCLK  &msc SCRL_DOWN    &mmv MOVE_UP     &msc SCRL_UP     &kp LS(LBKT)         &kp LS(RBKT)
              &kp ESC  &mt K_APP LS(LBKT)         &kp LS(RBKT)              &kp LS(N9)           &kp LS(N0)    &kp DEL                                                                         &msc SCRL_LEFT  &mmv MOVE_LEFT  &mmv MOVE_DOWN  &mmv MOVE_RIGHT  &msc SCRL_RIGHT              &kp DEL
            &kp GRAVE              &kp F9  &mo LAYER_MouseSlow  &mo LAYER_MousePrecise  &mo LAYER_MouseWarp  &kp K_APP  &kp LSHFT  &to LAYER_Base   &kp LALT   &kp LALT  &kp LCTRL  &mkp MCLK       &mkp RCLK        &mkp MB4    &msc SCRL_UP         &mkp MB5         &kp LBKT             &kp RBKT
 &magic LAYER_Magic 0           &kp PSCRN      &mt C_MUTE C_PP            &kp C_VOL_DN         &kp C_VOL_UP              &kp BSPC  &to LAYER_Base  &kp LC(C)  &kp LC(V)  &mkp RCLK  &mkp LCLK                  &msc SCRL_LEFT  &msc SCRL_DOWN  &msc SCRL_RIGHT    &mt SLCK CAPS  &mt LA(PSCRN) PSCRN
            >;
        };

        layer_Gaming {
            bindings = <
 &to LAYER_Base      &kp P   &kp O   &kp N  &kp BSPC                                                                                   &kp F1     &kp F2    &kp F3     &kp F4     &kp F5
          &kp M     &kp N6  &kp N7  &kp N8    &kp N9  &kp N0                                                                &kp F6     &kp F7     &kp F8    &kp F9    &kp F10    &kp F11
          &kp I     &kp N5   &kp Q   &kp W     &kp E   &kp R                                                                 &kp Y      &kp U      &kp I     &kp O      &kp P    &kp F12
          &kp T  &kp LSHFT   &kp A   &kp S     &kp D   &kp F                                                                 &kp H      &kp J      &kp K     &kp L   &kp SEMI    &kp SQT
          &kp G  &kp LCTRL  &kp N1  &kp N2    &kp N3  &kp N4    &kp ESC   &kp LALT  &kp RET   &kp ESC    &kp UP    &kp RET   &kp N      &kp M  &kp COMMA   &kp DOT   &kp FSLH   &kp BSLH
          &kp B    &kp TAB   &kp Z   &kp X     &kp C          &kp SPACE  &kp LCTRL    &kp V  &kp LEFT  &kp DOWN  &kp RIGHT          &kp MINUS   &kp LBKT  &kp RBKT  &kp EQUAL  &kp GRAVE
            >;
        };

        layer_Numbers {
            bindings = <
 &trans     &trans  &trans  &trans         &trans                                                                                      &trans  &trans  &trans  &trans     &trans
 &trans     &trans  &trans  &trans         &trans  &trans                                                               &trans         &trans  &trans  &trans  &trans     &trans
 &trans  &kp EQUAL  &trans  &trans         &trans  &trans                                                               &trans         &trans  &trans  &trans  &trans     &trans
 &trans     &kp N1  &kp N2  &kp N3  &hrm LSHFT N4  &kp N5                                                               &kp N6  &hrm RSHFT N7  &kp N8  &kp N9  &kp N0  &kp MINUS
 &trans     &trans  &trans  &trans         &trans  &trans  &shiftdance  &trans  &trans  &to LAYER_Base  &trans  &trans  &trans         &trans  &trans  &trans  &trans     &trans
 &trans     &trans  &trans  &trans         &trans             &kp BSPC  &trans  &trans          &trans  &trans  &trans                 &trans  &trans  &trans  &trans     &trans
            >;
        };

        layer_MouseSlow {
            bindings = <
 &trans  &trans  &trans  &trans  &trans                                                                  &trans  &trans  &trans  &trans  &trans
 &trans  &trans  &trans  &trans  &trans  &trans                                                  &trans  &trans  &trans  &trans  &trans  &trans
 &trans  &trans  &trans  &trans  &trans  &trans                                                  &trans  &trans  &trans  &trans  &trans  &trans
 &trans  &trans  &trans  &trans  &trans  &trans                                                  &trans  &trans  &trans  &trans  &trans  &trans
 &trans  &trans  &trans  &trans  &trans  &trans  &trans  &trans  &trans  &trans  &trans  &trans  &trans  &trans  &trans  &trans  &trans  &trans
 &trans  &trans  &trans  &trans  &trans          &trans  &trans  &trans  &trans  &trans  &trans          &trans  &trans  &trans  &trans  &trans
            >;
        };

        layer_MousePrecise {
            bindings = <
 &trans  &trans  &trans  &trans  &trans                                                                  &trans  &trans  &trans  &trans  &trans
 &trans  &trans  &trans  &trans  &trans  &trans                                                  &trans  &trans  &trans  &trans  &trans  &trans
 &trans  &trans  &trans  &trans  &trans  &trans                                                  &trans  &trans  &trans  &trans  &trans  &trans
 &trans  &trans  &trans  &trans  &trans  &trans                                                  &trans  &trans  &trans  &trans  &trans  &trans
 &trans  &trans  &trans  &trans  &trans  &trans  &trans  &trans  &trans  &trans  &trans  &trans  &trans  &trans  &trans  &trans  &trans  &trans
 &trans  &trans  &trans  &trans  &trans          &trans  &trans  &trans  &trans  &trans  &trans          &trans  &trans  &trans  &trans  &trans
            >;
        };

        layer_MouseWarp {
            bindings = <
 &trans  &trans  &trans  &trans  &trans                                                                  &trans  &trans  &trans  &trans  &trans
 &trans  &trans  &trans  &trans  &trans  &trans                                                  &trans  &trans  &trans  &trans  &trans  &trans
 &trans  &trans  &trans  &trans  &trans  &trans                                                  &trans  &trans  &trans  &trans  &trans  &trans
 &trans  &trans  &trans  &trans  &trans  &trans                                                  &trans  &trans  &trans  &trans  &trans  &trans
 &trans  &trans  &trans  &trans  &trans  &trans  &trans  &trans  &trans  &trans  &trans  &trans  &trans  &trans  &trans  &trans  &trans  &trans
 &trans  &trans  &trans  &trans  &trans          &trans  &trans  &trans  &trans  &trans  &trans          &trans  &trans  &trans  &trans  &trans
            >;
        };

        layer_Mirror {
            bindings = <
   &kp F10       &kp F9       &kp F8        &kp F7         &kp F6                                                                                                         &kp F5        &kp F4       &kp F3       &kp F2                &kp F1
 &kp MINUS       &kp N0       &kp N9        &kp N8         &kp N7  &kp N6                                                                                  &kp N5         &kp N4        &kp N3       &kp N2       &kp N1             &kp EQUAL
  &kp BSLH     &kp SEMI        &kp Y         &kp U          &kp L   &kp J                                                                                   &kp B          &kp P         &kp F        &kp W        &kp Q               &kp TAB
   &kp SQT  &hrm LGUI O  &hrm LALT I  &hrm LCTRL E  &hrms LSHFT N   &kp M                                                                                   &kp G  &hrms RSHFT T  &hrm RCTRL S  &hrm RALT R  &hrm RGUI A               &kp ESC
 &kp PG_UP     &kp FSLH      &kp DOT     &kp COMMA          &kp H   &kp K  &kp K_APP  &kp RCTRL       &numdance          &lower  &mousedance  &shiftdance   &kp V          &kp D         &kp C        &kp X        &kp Z             &kp GRAVE
 &kp PG_DN     &kp RBKT     &kp LBKT      &kp DOWN         &kp UP          &kp SPACE    &kp RET  &to LAYER_Base  &to LAYER_Base      &kp DEL     &kp BSPC              &kp RIGHT      &kp LEFT     &kp LBKT     &kp RBKT  &magic LAYER_Magic 0
            >;
        };

    };
};
